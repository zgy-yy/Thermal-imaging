## sdkconfig.defaults
```kconfig
# Use main/lv_conf.h (do not enable LV_CONF_SKIP)
# CONFIG_LV_CONF_SKIP is not set
CONFIG_LV_USE_DEMO_MUSIC=y
CONFIG_LV_OS_FREERTOS=y
CONFIG_LV_MEM_SIZE_KILOBYTES=64
CONFIG_PARTITION_TABLE_SINGLE_APP_LARGE=y
```
